/dts-v1/;
/plugin/;

/ {
    compatible = "cvitek,cv180x";

    fragment@0 {
        target-path = "/";
        __overlay__ {
            cvi-spif@10000000 {
                status = "disabled";
            };
        };
    };
};